/ {
    macros {
        macro_nextsentence: macro_nextsentence {
            label = "parameterized DOT or ?, Space, Shift";
            compatible = "zmk,behavior-macro-one-param";
            bindings = <&macro_param_1to1 &kp MACRO_PLACEHOLDER>, <&kp SPACE &sk RSHFT>;
            #binding-cells = <1>;
        };

        macro_commaspace: macro_commaspace {
            label = "Send Comma and Space";
            compatible = "zmk,behavior-macro";
            bindings = <&kp COMMA &kp SPACE>;
            #binding-cells = <0>;
        };
    };
};
